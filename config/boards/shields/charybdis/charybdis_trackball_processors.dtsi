/*
 * Copyright (c) 2024 The ZMK Contributors
 * SPDX-License-Identifier: MIT
 * 
 * Trackball input processor configurations for Charybdis keyboard
 * Defines scroll, snipe, and move modes with layer bindings
 * Dual scroll modes: fast on QWERTY, slow on NUM_AND_FUN
 * SEPARATE VERTICAL/HORIZONTAL SCROLL SPEED (horizontal 3-4x slower)
 * 
 * IMPORTANT: Order matters! More specific layer bindings should come first
 * to prevent fallback to wrong modes.
 */

#include "charybdis_layers.h"
#include <dt-bindings/zmk/input_transform.h>
#include <zephyr/dt-bindings/input/input-event-codes.h>
#include <input/processors.dtsi>

/ {
  input_processors {
    // Custom scaler for VERTICAL scroll (Y-axis, wheel)
    zip_wheel_scaler: zip_wheel_scaler {
      compatible = "zmk,input-processor-scaler";
      #input-processor-cells = <2>;
      type = <INPUT_EV_REL>;
      codes = <INPUT_REL_WHEEL>;
      track-remainders;
    };

    // Custom scaler for HORIZONTAL scroll (X-axis, hwheel)
    zip_hwheel_scaler: zip_hwheel_scaler {
      compatible = "zmk,input-processor-scaler";
      #input-processor-cells = <2>;
      type = <INPUT_EV_REL>;
      codes = <INPUT_REL_HWHEEL>;
      track-remainders;
    };
  };
};

// Standard trackball processing configuration
// Configures different trackball behaviors for different layers
// Order: snipe -> move -> scroll_slow -> scroll (base as fallback)
#define CHARYBDIS_TRACKBALL_PROCESSORS \
    snipe { \
        layers = <SNIPE>; \
        input-processors = <&zip_xy_scaler 1 3>; \
    }; \
    \
    move { \
        layers = <AUTO_MOUSE>; \
        input-processors = <&zip_xy_scaler 1 1>; \
    }; \
    \
    scroll_slow { \
        layers = <NUM_AND_FUN>; \
        input-processors = <&zip_xy_transform (INPUT_TRANSFORM_Y_INVERT)>, \
                           <&zip_xy_scaler 1 120>, \
                           <&zip_xy_to_scroll_mapper>, \
                           <&zip_wheel_scaler 1 1>, \
                           <&zip_hwheel_scaler 1 3>; \
    }; \
    \
    scroll { \
        layers = <QWERTY>; \
        input-processors = <&zip_xy_transform (INPUT_TRANSFORM_Y_INVERT)>, \
                           <&zip_xy_scaler 1 40>, \
                           <&zip_xy_to_scroll_mapper>, \
                           <&zip_wheel_scaler 1 1>, \
                           <&zip_hwheel_scaler 1 4>; \
    };
