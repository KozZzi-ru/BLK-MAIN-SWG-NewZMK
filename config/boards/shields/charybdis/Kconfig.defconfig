## config/boards/shields/charybdis/Kconfig.defconfig
```kconfig
if SHIELD_CHARYBDIS_DONGLE

config ZMK_KEYBOARD_NAME
    default "Charybdis46_Dongle"

config ZMK_SPLIT_ROLE_CENTRAL
    default y

config ZMK_SPLIT
    default y

config ZMK_SPLIT_BLE_CENTRAL_PERIPHERALS
    default 2

config BT_MAX_CONN
    default 5

config BT_MAX_PAIRED
    default 5

endif

if SHIELD_CHARYBDIS_LEFT || SHIELD_CHARYBDIS_RIGHT

config ZMK_SPLIT_ROLE_CENTRAL
    default n

endif

if SHIELD_CHARYBDIS_RIGHT

config ZMK_KEYBOARD_NAME
    default "Charybdis46_Black4"

endif
```
