#include "charybdis.dtsi"
#include "charybdis_trackball_processors.dtsi"
#include <dt-bindings/zmk/matrix_transform.h>

/ {
    chosen {
        zmk,kscan = &mock_kscan;
        zmk,matrix_transform = &default_transform;
    };

    mock_kscan: mock_kscan_0 {
        compatible = "zmk,kscan-mock";
        columns = <16>;
        rows = <5>;
        events = <0>;
    };

    // Узел-приемник данных от правой периферии
    input_split: input_split@0 {
        compatible = "zmk,input-split";
        status = "okay";
        reg = <0 1>;
    };

    // Локальный слушатель на донгле, который применяет слои (scroll, snipe, move)
    dongle_trackball_listener {
        compatible = "zmk,input-listener";
        status = "okay";
        device = <&input_split>;
        CHARYBDIS_TRACKBALL_PROCESSORS
    };
};

&kscan0 {
    status = "disabled";
};
